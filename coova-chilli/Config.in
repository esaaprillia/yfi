## coova-chilli/Config.in
```kconfig
# CoovaChilli advanced configuration

menu "Configuration"
	depends on PACKAGE_coova-chilli

config COOVACHILLI_PROXY
        bool "Enable support for chilli proxy. Required for AAA Proxy through http"
        default y

config COOVACHILLI_REDIR
	bool "Enable support for redir server. Required for uamregex"
	default y

config COOVACHILLI_MINIPORTAL
	bool "Enable support Coova miniportal"
	default n

config COOVACHILLI_USERAGENT
	bool "Enable recording user-agent"
	default y

config COOVACHILLI_DNSLOG
	bool "Enable support to log DNS name queries"
	default y

config COOVACHILLI_UAMDOMAINFILE
	bool "Enable loading of mass uamdomains from file"
	default y

config COOVACHILLI_LARGELIMITS
	bool "Enable larger limits for use with non-embedded systems"
	default y

choice
	prompt "SSL library"
	default COOVACHILLI_OPENSSL

config COOVACHILLI_NOSSL
	bool "No SSL support"

config COOVACHILLI_CYASSL
	bool "CyaSSL"

config COOVACHILLI_OPENSSL
	bool "OpenSSL"

endchoice

endmenu
```

## freeradius2/Config.in
```kconfig
# FreeRADIUS avanced configuration

choice
	prompt "SSL library"
	default FREERADIUS2_NOSSL
	depends on PACKAGE_freeradius2-common

config FREERADIUS2_NOSSL
	bool "No SSL support"

config FREERADIUS2_OPENSSL
	bool "OpenSSL"

endchoice
```
